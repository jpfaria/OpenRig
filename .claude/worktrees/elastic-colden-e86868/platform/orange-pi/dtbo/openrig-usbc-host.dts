/dts-v1/;
/plugin/;

// OpenRig DTB overlay for Orange Pi 5B — USB-C port stability fix.
//
// PROBLEM:
//   The USB-C port on the OPi5B hangs off a Rockchip RK3588 DWC3 DRD
//   controller (/usb@fc000000 → xhci-hcd.7.auto) that, in Armbian's mainline
//   kernel, delegates VBUS and role management to the TCPM state machine
//   running on the FUSB302 Type-C PD controller (i2c@fec80000/usb-typec@22).
//   The FUSB302 sporadically samples the CC1/CC2 lines as 0V under any
//   sustained USB traffic — most likely EMI crosstalk from the adjacent
//   D+/D- pair inside the Type-C cable combined with ground noise from the
//   extra current draw of the downstream device. TCPM reads the CC drop as
//   a physical disconnect, flips state SRC_READY → SNK_UNATTACHED, and
//   commands the vbus_typec fixed regulator OFF. VBUS dies on a working
//   device; xHCI then observes its downstream device vanish and tears down
//   the root hub.
//
//   This is a generic bug of the FUSB302/TCPM stack on the RK3588 USB-C
//   port and affects ANY USB device plugged into the USB-C port under
//   load — audio interfaces, mass storage, Ethernet adapters, hubs. It is
//   NOT specific to any one vendor or class; we reproduced it with a
//   Focusrite Scarlett 2i2 Gen 4 because isochronous audio at 48 kHz is the
//   workload OpenRig always runs, but the failure mode is the same for any
//   device that sustains traffic long enough for the CC lines to see a
//   glitch.
//
//   Smoking-gun evidence from /sys/kernel/debug/usb/tcpm-6-0022/log,
//   captured live during a crash at t=221.36s while a Scarlett was
//   streaming:
//     [  221.363476] CC1: 2 -> 0, CC2: 1 -> 0 [state SRC_READY, polarity 0, disconnected]
//     [  221.363488] state change SRC_READY -> SNK_UNATTACHED [rev3 NONE_AMS]
//     [  221.378407] VBUS off
//     [  221.378412] VBUS VSAFE0V
//   …followed immediately by the xHCI disconnect / xhci-hcd teardown in
//   dmesg. The kernel deliberately killed power to the device.
//
// FIX:
//   OpenRig on OPi5B is a kiosk appliance that uses HDMI for the display and
//   never needs any Type-C alt-mode, PD role swap, or upstream-facing mode
//   on the USB-C port — the port only ever hosts downstream USB devices. So
//   we can safely take the TCPM stack out of the picture entirely:
//
//     fragment@0  Disable FUSB302 node → TCPM never runs, CC lines are
//                 never sampled, no spurious disconnect events can fire.
//     fragment@1  Mark vbus_typec regulator always-on + boot-on → VBUS on
//                 the USB-C port is held hard high regardless of TCPM
//                 state, so nothing can power-gate the Scarlett mid-stream.
//     fragment@2  Force DWC3 dr_mode = "host" and delete usb-role-switch →
//                 DWC3 becomes a plain USB host, never waits for a
//                 role-switch partner that no longer exists.
//
//   100% reversible: remove the `user_overlays=` line from armbianEnv.txt
//   and reboot to restore stock TCPM behaviour.
//
// TRADE-OFFS:
//   - No USB-C DisplayPort alt-mode. (Appliance uses HDMI, so N/A.)
//   - No USB-PD negotiation on the Type-C port. VBUS is a fixed 5 V from
//     vbus_typec regardless of any sink cap message.
//   - Role is permanently host; plugging the board into a PC as a device
//     is not supported via this port in the OpenRig image.
//
// TARGETING:
//   Uses target-path (absolute DT path) rather than label references so the
//   overlay compiles cleanly against Armbian's base DTB without needing any
//   specific label to be exported in __symbols__. Paths verified live on
//   /sys/firmware/devicetree/base/ during the issue #225 audit.

/ {
    compatible = "rockchip,rk3588s-orangepi-5b",
                 "xunlong,orangepi-5b",
                 "rockchip,rk3588s";

    // ── 0. Disable the FUSB302 Type-C PD controller ──────────────────────
    // Kills TCPM. CC lines are no longer monitored. No disconnect events.
    fragment@0 {
        target-path = "/i2c@fec80000/usb-typec@22";
        __overlay__ {
            status = "disabled";
        };
    };

    // ── 1. Pin vbus_typec regulator hard ON ──────────────────────────────
    // VBUS on the USB-C port is held at 5 V forever; nothing can turn it
    // off now that TCPM is gone.
    fragment@1 {
        target-path = "/regulator-vbus-typec";
        __overlay__ {
            regulator-always-on;
            regulator-boot-on;
        };
    };

    // ── 2. Force the DWC3 @fc000000 into pure host mode ──────────────────
    // Setting dr_mode = "host" is enough on its own: drivers/usb/dwc3/core.c
    // only enters the OTG / role-switch code path (dwc3_drd_init, which is
    // what would block waiting on a usb_role_switch consumer) when dr_mode
    // is USB_DR_MODE_OTG. In USB_DR_MODE_HOST it calls dwc3_host_init()
    // directly and the stale usb-role-switch property on this node is
    // ignored. We cannot remove the property from here anyway — dtc drops
    // /delete-property/ inside an __overlay__ block silently, so overlays
    // can only add or replace properties, never delete them.
    fragment@2 {
        target-path = "/usb@fc000000";
        __overlay__ {
            dr_mode = "host";
        };
    };
};
